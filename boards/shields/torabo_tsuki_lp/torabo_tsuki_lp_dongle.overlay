#include <input/processors.dtsi>
#include <dt-bindings/zmk/input_transform.h>
#include "torabo_tsuki_lp_layouts.dtsi"

&physical_layout_m {
    transform = <&keymap_transform_1>;
};

/ {
    chosen {
        zmk,kscan = &mock_kscan;
        zmk,physical-layout = &physical_layout_m;
    };

    mock_kscan: mock_kscan_0 {
        compatible = "zmk,kscan-mock";
        columns = <0>;
        rows = <0>;
        events = <0>;
    };
};