## boards/shields/torabo_tsuki_lp/Kconfig.defconfig
```kconfig
if SHIELD_TORABO_TSUKI_LP_LEFT || SHIELD_TORABO_TSUKI_LP_RIGHT || SHIELD_TORABO_TSUKI_LP_DONGLE

config ZMK_KEYBOARD_NAME
    default "ttlm50"

config ZMK_SPLIT
    default y

config SPI
    default y

config INPUT
    default y

config ZMK_MOUSE
    default y
 
endif

if SHIELD_TORABO_TSUKI_LP_DONGLE

config ZMK_SPLIT_BLE_CENTRAL_PERIPHERALS
    default 2

config BT_MAX_CONN
    default 6

config BT_MAX_PAIRED
    default 6

endif
```
