## dts/bindings/zmk,input-processor-dominant-axis.yaml
```yaml
description: Dominant-axis filter for relative pointer or scroll events.

compatible: "zmk,input-processor-dominant-axis"

include: base.yaml

properties:
  "#input-processor-cells":
    type: int
    required: true
    const: 0

  track-remainders:
    type: boolean

  type:
    type: int
    default: 2 # INPUT_EV_REL

  x-code:
    type: int
    default: 6 # INPUT_REL_HWHEEL

  y-code:
    type: int
    default: 8 # INPUT_REL_WHEEL

  deadzone:
    type: int
    default: 1

  dominance-ratio-num:
    type: int
    default: 1

  dominance-ratio-den:
    type: int
    default: 1
```
